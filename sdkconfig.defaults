## sdkconfig.defaults
```kconfig
# Serial flasher config
CONFIG_ESPTOOLPY_FLASHSIZE_4MB=y

# ESP32-specific config
CONFIG_ESP32_DEFAULT_CPU_FREQ_240=y

# System settings
CONFIG_FREERTOS_HZ=1000

# I2C settings
CONFIG_I2C_SUPPORT=y

# SPI settings
CONFIG_SPI_MASTER=y

# GPIO settings
CONFIG_GPIO=y

# UART settings
CONFIG_UART_CONSOLE=y
CONFIG_CONSOLE_UART_DEFAULT=y
CONFIG_IDF_TARGET_ESP32S3=y
CONFIG_FREERTOS_UNICORE=n
CONFIG_LVGL_ENABLED=y
CONFIG_LVGL_VERSION_8_3=y
CONFIG_LVGL_TICK_PERIOD_MS=5
CONFIG_LVGL_MAX_DRAW_BUF_SIZE=8192
CONFIG_LVGL_BITS_PER_PIXEL=16
CONFIG_I2C_PORT_0_SCL=17
CONFIG_I2C_PORT_0_SDA=18
CONFIG_I2C_PORT_0_SPEED_HZ=100000
CONFIG_ESP_WIFI_ENABLED=y
CONFIG_ESP_WIFI_STA_ENABLED=y
CONFIG_ESP_TASK_WDT_TIMEOUT_S=10
```
